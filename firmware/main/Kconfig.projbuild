## firmware/main/Kconfig.projbuild
```kconfig
menu "Pita-flow Configuration"

    config PITA_FLOW_WIFI_SSID
        string "Wi-Fi SSID"
        default "myssid"
        help
            SSID (network name) for the reflow controller to connect to.
            Wi-Fi connectivity is best-effort only: the heater control loop
            must remain fully functional even if this network is unreachable.

    config PITA_FLOW_WIFI_PASSWORD
        string "Wi-Fi Password"
        default "mypassword"
        help
            WPA2 passphrase for the SSID above.

endmenu
```

## firmware/sdkconfig.defaults
```kconfig
# Target: ESP32-C3 Super Mini (ESP32-C3FH4-based board), see
# docs/firmware-plan.md "Platform".
CONFIG_IDF_TARGET="esp32c3"

# Fail-safe boot: keep watchdogs enabled.
CONFIG_ESP_TASK_WDT_EN=y

# NVS is used by config_store for persisted configuration.
CONFIG_NVS_ENCRYPTION=n
```
